## package/firmware/myfpga/Config.in
```kconfig
config PACKAGE_firmware-myfpga
	bool "My FPGA bitstream"
	default n
	help
	  Installs the custom FPGA bitstream (design_1_wrapper.bit) to /lib/firmware.
```
